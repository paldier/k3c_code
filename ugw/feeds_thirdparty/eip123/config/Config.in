## ugw/feeds_thirdparty/eip123/config/Config.in
```kconfig
config BUILD_IA_ONLY
	bool
  prompt "build image authenticator only"
  default ""
  help
      Select it when we want to support only IA

config RAM_CAPACITY
	hex
	prompt "configure the total ram"
	default "0x20000000"
	help
			input the total ram capacity here

config PHYS_RAM_OFFSET
	hex
	prompt "configure the ram start address"
	default "0x20000000"
	help
			input the ram start address here

config TEST_TSS
	bool
	prompt "Test the tss using sample app"
	depends on !BUILD_IA_ONLY
	default n
	help
		test the tss app using the test app, uses the top 1MB RAM of TEP

config DRM_NORMAL_FLOW
	bool
	prompt "Use the normal DDK flow"
  depends on !BUILD_IA_ONLY
  default n
  help
    use the ddk flow for DRM streaming rather than optimised version

config DRM_FLUSH
	bool 
	prompt "use the cache flush function in DDK for DRM flow"
	depends on DRM_NORMAL_FLOW
	help
		use the cache flush function for normal DRM flow, if needed

config UPDATE_OTP_ROLLBACK_ID
	bool
	prompt "update chip Anti Rollback ID"
	default n
	help
		update chip Anti Rollback ID when image rollback id is greater than current id
```

## ugw/feeds_ugw/misc/ifxos/config/Config.in
```kconfig
config IFXOS_IPV6_SUPPORT
	bool "IPv6 support"
	default n
	help
		Option to enable IPv6 support
```

## ugw/feeds_ugw/network/network/config/Config.in
```kconfig
config FEATURE_MULTI_BRIDGE
	bool 'Enable multi bridge support'
        default n
	help
	  To enable multiple birdging support.
```

## ugw/feeds_ugw/system/ltq-pm-util/config/Config.in
```kconfig
config LTQ_PM_UTIL_USER_FLAGS
	depends on PACKAGE_ltq-pm-util
	string "Additional CFLAGS"
	default ""
	help
		Additional CFLAGS for compilation (for developers)
		(e.g -O0) 

choice
	prompt "cpu frequency scaling"
	default LTQ_CPUFREQ_DISABLED
	help
	  Define the load dependend cpu frequency scaling.

	config LTQ_CPUFREQ_ENABLED
		bool "enable dynamic cpu frequency scaling"
		help
		  Set governor to LANTIQGOV and enable Sub System Control.

	config LTQ_CPUFREQ_DISABLED
		bool "disable dynamic cpu frequency scaling"
		help
		  Set governor to USERSPACE and disable Sub System Control.
endchoice 

choice
	prompt "dynamic voltage scaling"
	default LTQ_DVS_DISABLED
	help
	  Define if dynamic core voltage scaling is active or not.
	  Only the digital core voltage will be scaled depending on the
	  speed grade of the current device.

	config LTQ_DVS_ENABLED
		bool "enable dynamic voltage scaling"
		help
		  Depending on the speed grade of the device, which will be checked
		  during boot-up, a specific digital core voltage will be set via
		  an I2C controlable dcdc.

	config LTQ_DVS_DISABLED
		bool "disable dynamic voltage scaling"
		help
		  I2C control of the dcdc is disabled(default) and the core
		  voltage is defined by the hardware settings.
endchoice 
```

## ugw/feeds_ugw/system/ltq-pmcu/config/Config.in
```kconfig
config LTQ_PMCU_DEBUG
	bool
	prompt "Enable debug features"
	default n
	help 
	  This option enables debug prints and set -O0 for no optimization during
	  compilation for better debugging.

config LTQ_PMCU_DEBUG_TEMP
	bool
	prompt "Enable temperature sensor degugging"
	default y
	help 
	  This option enables the possibility to fake the temperature sensor
	  output value for easier and faster debugging. If this option is set
	  the temperature value will not taken from the hardware sensor anymore.
	  Instead the value can be defined and easily changed via sys-fs. This
	  can be used to quickly check the thermal SW control loop without
	  heating and cooling up and down the chip many times.

 
```

## ugw/feeds_ugw/system/ltq-ppmd/config/Config.in
```kconfig
config LTQ_PPMD_USER_FLAGS
	depends on PACKAGE_ltq-ppmd
	string "Additional CFLAGS"
	default ""
	help
		Additional CFLAGS for compilation (for developers)
		(--enable-debug) 
config LTQ_TEMP_EMER_SHUT_DOWN
	bool "enable emergency shut down"
	default n 
	help
	  In case the temperature limit for the chip (default 125°C) is reached,
	  the PPMD will trigger a system reboot.

config LTQ_SCALE_DOWN_ON_HIGH_TEMP
	bool "enable frequency down scaling on high temperature"
	default n 
	help
	  In case pre defined temperature thresholds are reached,
	  the PPMD will trigger a frequency down scaling to the next lower power state.
          If the temperature falls back under the given threshold the frequency
          will be increased again.
```

## ugw/feeds_ugw/system/ltq-regulator-consumer/config/Config.in
```kconfig
config LTQ_REGULATOR_CONSUMER_DEBUG
	bool
	prompt "Enable debug prints"
	default n
	help 
	  This option enables debug outputs of the regulator consumer driver.
 
```

## ugw/feeds_ugw/system/ltq-regulator-cpufreq/config/Config.in
```kconfig
config LTQ_REGULATOR_CPUFREQ_DEBUG
	bool
	prompt "Enable debug prints"
	default n
	help 
	  This option enables debug outputs of the regulator CPUFreq driver.
 
```

## ugw/feeds_ugw/system/ltq-temp/config/Config.in
```kconfig
config LTQ_TEMP_DEBUG
	bool
	prompt "Enable debug features"
	default n
	help 
	  This option enables debug ability of the TempSensor driver for
	  Lantiq SoC's.
 
```
